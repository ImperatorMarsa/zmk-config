/*
 * Copyright (c) 2022 The ZMK Contributors
 *
 * SPDX-License-Identifier: MIT
 */

#include <behaviors.dtsi>
#include <dt-bindings/zmk/keys.h>
#include <dt-bindings/zmk/bt.h>
#include <dt-bindings/zmk/outputs.h>

#define HOST_OS 1

#include "../zmk-helpers/helper.h"
#include "../zmk-helpers/international_chars/russian.dtsi"

ZMK_LAYER(default_layer,
     // ╭──────────────╮
          &ru_ya
     // ├──────────────┤
          &out OUT_BLE
     // ╰──────────────╯
)
